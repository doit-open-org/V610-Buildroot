## Config.in
```kconfig
menu "HiSilicon Hi3516CV610"
	source "$BR2_EXTERNAL_CV610_PATH/package/hisi-osdrv/Config.in"
	source "$BR2_EXTERNAL_CV610_PATH/package/hisi-boot/Config.in"
	source "$BR2_EXTERNAL_CV610_PATH/package/aic8800d-sdio/Config.in"
	source "$BR2_EXTERNAL_CV610_PATH/package/board-io-cfg/Config.in"
	source "$BR2_EXTERNAL_CV610_PATH/package/lcd-driver/Config.in"
	source "$BR2_EXTERNAL_CV610_PATH/package/touch-driver/Config.in"
endmenu
```

## board/cove_610/linux_image.its
```
/dts-v1/;

/*
 * The LCD and the SD card slot share the SDIO1 pins, so the board has one
 * device tree for each, plus one with neither. U-Boot boots conf-${sdio1_pins}; see post-image.sh.
 */

/ {
	description = "Linux Kernel";
	#address-cells = <1>;

	images {
		fdt-lcd {
			description = "dtb: SPI LCD and touch";
			data = /incbin/("./devicetree-lcd.dtb");
			type = "flat_dt";
			arch = "arm";
			compression = "none";
			load = <0x40000000>;
		};

		fdt-sd {
			description = "dtb: SD card";
			data = /incbin/("./devicetree-sd.dtb");
			type = "flat_dt";
			arch = "arm";
			compression = "none";
			load = <0x40000000>;
		};

		fdt-none {
			description = "dtb: no LCD, no SD card";
			data = /incbin/("./devicetree-none.dtb");
			type = "flat_dt";
			arch = "arm";
			compression = "none";
			load = <0x40000000>;
		};

		linux_kernel {
			description = "Linux";
			data = /incbin/("./zImage");
			type = "kernel";
			arch = "arm";
			os = "Linux";
			compression = "none";
			load = <0x40018000>;
			entry = <0x40018000>;
		};
	};

	configurations {
		default = "conf-lcd";
		conf-lcd {
			description = "Linux, SPI LCD and touch";
			kernel = "linux_kernel";
			fdt = "fdt-lcd";
			loadables = "linux_kernel", "fdt-lcd";
		};
		conf-sd {
			description = "Linux, SD card";
			kernel = "linux_kernel";
			fdt = "fdt-sd";
			loadables = "linux_kernel", "fdt-sd";
		};
		conf-none {
			description = "Linux, no LCD, no SD card";
			kernel = "linux_kernel";
			fdt = "fdt-none";
			loadables = "linux_kernel", "fdt-none";
		};
	};
};
```

## package/aic8800d-sdio/Config.in
```kconfig
config BR2_PACKAGE_AIC8800D_SDIO
	bool "aic8800d-sdio (AIC8800D80 SDIO Wi-Fi/BLE)"
	depends on BR2_LINUX_KERNEL
	depends on BR2_PACKAGE_HISI_OSDRV # bspmm, for the SDIO0 pin mux
	select BR2_PACKAGE_WPA_SUPPLICANT
	select BR2_PACKAGE_WPA_SUPPLICANT_NL80211
	select BR2_PACKAGE_WPA_SUPPLICANT_CLI
	help
	  AICSemi AIC8800D80 SDIO Wi-Fi driver (vendor SDK V5.0) for
	  the module fitted on SDIO0 of the Cove-610, with its
	  firmware and start-up scripts.

	  /etc/init.d/S51wireless sets the SDIO0 pin mux, loads the
	  modules and brings wlan0 up. It does not connect: edit
	  /etc/wireless/wpa_supplicant.conf and run
	  "wifi-service start".

if BR2_PACKAGE_AIC8800D_SDIO

config BR2_PACKAGE_AIC8800D_SDIO_BLE
	bool "BLE over SDIO"
	depends on BR2_USE_WCHAR # bluez5_utils
	depends on BR2_TOOLCHAIN_HAS_THREADS # bluez5_utils
	depends on BR2_USE_MMU # bluez5_utils
	depends on !BR2_STATIC_LIBS # bluez5_utils
	depends on BR2_TOOLCHAIN_HAS_SYNC_4 # bluez5_utils
	select BR2_PACKAGE_BLUEZ5_UTILS
	help
	  Build the driver with its SDIO HCI transport, load the
	  kernel Bluetooth stack and the combined Wi-Fi/BLE firmware,
	  and install BlueZ. The controller registers as hci0.

	  The kernel must have CONFIG_BT, CONFIG_CRYPTO_ECC and
	  CONFIG_CRYPTO_ECDH built as modules.

	  bluetoothd is not started at boot: use
	  "ble-service start|stop|status".

endif

comment "aic8800d-sdio needs a Linux kernel and hisi-osdrv"
	depends on !BR2_LINUX_KERNEL || !BR2_PACKAGE_HISI_OSDRV
```

## package/board-io-cfg/Config.in
```kconfig
config BR2_PACKAGE_BOARD_IO_CFG
	bool "board-io-cfg (Hi3516CV610 board pin configuration module)"
	depends on BR2_LINUX_KERNEL
	help
	  Kernel module that applies the board pin configuration: on
	  load it reads the pin-cfg nodes of the device tree
	  (board_io_config.dtsi), looks the pins up in its built-in
	  IOCFG tables and writes the registers.

	  Installed as /drv/ko/ot_board_io_cfg.ko. The LCD and touch
	  control scripts load it before their drivers.

comment "board-io-cfg needs a Linux kernel"
	depends on !BR2_LINUX_KERNEL
```

## package/hisi-boot/Config.in
```kconfig
config BR2_PACKAGE_HISI_BOOT
	bool "hisi-boot (Hi3516CV610 GSL + U-Boot boot image)"
	depends on BR2_arm
	depends on BR2_PACKAGE_HISI_OSDRV
	help
	  Builds boot_image.bin for the Hi3516CV610: the DDR/PLL
	  register table, the GSL first stage loader and the vendor
	  U-Boot 2022.07, packed by the vendor image tool.

	  The vendor tools run with the build machine's python3, which
	  must provide the openpyxl and pycryptodome modules.

if BR2_PACKAGE_HISI_BOOT

choice
	prompt "boot medium"
	default BR2_PACKAGE_HISI_BOOT_MEDIA_SPI_NAND

config BR2_PACKAGE_HISI_BOOT_MEDIA_SPI_NAND
	bool "SPI NAND"

config BR2_PACKAGE_HISI_BOOT_MEDIA_SPI
	bool "SPI NOR"

config BR2_PACKAGE_HISI_BOOT_MEDIA_EMMC
	bool "eMMC"

endchoice

config BR2_PACKAGE_HISI_BOOT_MEDIA
	string
	default "spi_nand" if BR2_PACKAGE_HISI_BOOT_MEDIA_SPI_NAND
	default "spi" if BR2_PACKAGE_HISI_BOOT_MEDIA_SPI
	default "emmc" if BR2_PACKAGE_HISI_BOOT_MEDIA_EMMC

config BR2_PACKAGE_HISI_BOOT_DEBUG
	bool "debug U-Boot configuration"
	default y
	help
	  Use hi3516cv610[_emmc]_debug_defconfig: the U-Boot console
	  stays enabled and the environment is read from flash. The
	  release configuration embeds the environment in U-Boot and
	  disables the boot delay.

config BR2_PACKAGE_HISI_BOOT_REGBIN_XLSM
	string "DDR/PLL register table (xlsm)"
	default "Hi3516CV610-DMEB_4L_DDR3_2133M_128MB_16bit-A7_950M_QFN.xlsm"
	help
	  Name of a table under boards/dmeb/tools/pc/boot_tools in the
	  vendor SDK, or an absolute path to a custom one. It must
	  match the DDR part fitted on the board.

endif
```

## package/hisi-osdrv/Config.in
```kconfig
config BR2_PACKAGE_HISI_OSDRV
	bool "hisi-osdrv (Hi3516CV610 MPP drivers and libraries)"
	depends on BR2_arm
	depends on BR2_LINUX_KERNEL
	depends on BR2_TOOLCHAIN_USES_MUSL # prebuilt MPP libraries are musl only
	depends on BR2_INSTALL_LIBSTDCPP
	help
	  HiSilicon Hi3516CV610 media platform (MPP): kernel modules
	  built against the Buildroot kernel, the prebuilt user-space
	  MPP libraries, sensor libraries and the SDK headers.

	  Modules are installed to /drv/ko, libraries to /usr/lib and
	  headers to the staging directory under /usr/include/hisi.

	  The prebuilt libraries are ARMv7-A soft-float EABI binaries
	  linked against musl, so the toolchain must match.

if BR2_PACKAGE_HISI_OSDRV

config BR2_PACKAGE_HISI_OSDRV_TARBALL
	string "vendor SDK tarball"
	default "$(BR2_EXTERNAL_CV610_PATH)/vendor/Hi3516CV610_tag_V2.1.0_Beta.tgz"
	help
	  Path to the Hi3516CV610 community SDK tarball. It is shared
	  with the hisi-boot package.

config BR2_PACKAGE_HISI_OSDRV_SENSORS_DIR
	string "extra sensor sources directory"
	default "$(BR2_EXTERNAL_CV610_PATH)/package/hisi-osdrv/sensors"
	help
	  Directory holding one sub-directory per sensor model. Each
	  one is copied into the SDK sensor tree and built together
	  with the MPP libraries (libsns_<model>.so). Leave empty to
	  build only the sensors shipped in the SDK.

config BR2_PACKAGE_HISI_OSDRV_SAMPLES
	bool "install all MPP samples"
	help
	  Build every sample under samples/mpp and install the
	  binaries to /opt/hisi/samples. sdk_server is always built
	  and installed to /usr/sbin, with or without this option.

endif

comment "hisi-osdrv needs a Linux kernel and a musl toolchain w/ C++"
	depends on BR2_arm
	depends on !BR2_LINUX_KERNEL || !BR2_TOOLCHAIN_USES_MUSL || !BR2_INSTALL_LIBSTDCPP
```

## package/lcd-driver/Config.in
```kconfig
config BR2_PACKAGE_LCD_DRIVER
	bool "lcd-driver (ST7789V SPI LCD DRM driver)"
	depends on BR2_LINUX_KERNEL
	select BR2_PACKAGE_BOARD_IO_CFG
	help
	  DRM driver for the Sitronix ST7789V 240x320 SPI LCD module
	  of the Cove-610, built as an external kernel module, with
	  lcd_driver_ctl to load and unload it and
	  /etc/lcd-driver.conf describing the panel.

	  The kernel needs CONFIG_DRM_EXTERNAL_MIPI_DBI. The panel
	  wiring is described in
	  board/cove_610/dts/lcd_panel_config.dtsi.

if BR2_PACKAGE_LCD_DRIVER

config BR2_PACKAGE_LCD_DRIVER_AUTOLOAD
	bool "load the driver at boot"
	default y
	help
	  Install /etc/init.d/S30lcd. Without it a program loads the
	  driver with "lcd_driver_ctl start" when it needs the display.

endif

comment "lcd-driver needs a Linux kernel"
	depends on !BR2_LINUX_KERNEL
```

## package/touch-driver/Config.in
```kconfig
config BR2_PACKAGE_TOUCH_DRIVER
	bool "touch-driver (FT6336U touchscreen driver)"
	depends on BR2_LINUX_KERNEL
	select BR2_PACKAGE_BOARD_IO_CFG
	help
	  Driver for the FocalTech FT6336U touch controller of the
	  Cove-610 LCD module. The source is the kernel's own
	  edt-ft5x06.c, built as an external module so that it is
	  loaded after the board pin configuration, with
	  touch_driver_ctl and /etc/touch-driver.conf.

	  The controller wiring is described in
	  board/cove_610/dts/touch_config.dtsi.

if BR2_PACKAGE_TOUCH_DRIVER

config BR2_PACKAGE_TOUCH_DRIVER_AUTOLOAD
	bool "load the driver at boot"
	default y
	help
	  Install /etc/init.d/S31touch. Without it a program loads the
	  driver with "touch_driver_ctl start" when it needs touch
	  input.

endif

comment "touch-driver needs a Linux kernel"
	depends on !BR2_LINUX_KERNEL
```
