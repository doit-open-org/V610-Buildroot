// SPDX-License-Identifier: GPL-2.0-only
/*
 * Cove-610 board with neither the SPI LCD nor the SD card slot: SDIO1 is
 * disabled and its pins are left alone. As in the SD variant, UART1 and the
 * LSADC keep their pins.
 */

#include <dt-bindings/gpio/gpio.h>
#include <dt-bindings/interrupt-controller/irq.h>
#include "hi3516cv610-demb.dts"
#include "board_io_config.dtsi"

/ {
	model = "Doit Cove-610";
};

/* SPI NAND boot uses SDIO0 for the onboard AIC8800D Wi-Fi module. */
&mmc0 {
	status = "disabled";
};

&sdio0 {
	status = "okay";
};

&sdio1 {
	status = "disabled";
};
